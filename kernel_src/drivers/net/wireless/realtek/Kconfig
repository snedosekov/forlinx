## kernel_src/drivers/net/wireless/realtek/Kconfig
```kconfig
menuconfig REALTEK_WIFI
	tristate "Realtek wifi"	

if REALTEK_WIFI


choice 
	prompt "select wifi type"
	default RTL8189ES

config RTL8189ES
	depends on REALTEK_WIFI
	tristate "rtl8189es sdio wifi"


config RTL8192CU
	depends on REALTEK_WIFI
	tristate "rtl8192cu usb wifi"

endchoice 
endif
```

## kernel_src/drivers/net/wireless/realtek/rtl8189es/Kconfig
```kconfig
config RTL8189ES
	tristate "Realtek 8189es SDIO WiFi"
	---help---
	  Help message of RTL8188EU
```

## kernel_src/drivers/net/wireless/rtl8188C_8192C/Kconfig
```kconfig
config RTL8192CU
	tristate "Realtek 8188C/8192C USB WiFi"
	---help---
	  Help message of RTL8192CU  and RTL8188CU
```
